## boards/shields/gibson/Kconfig.shield
```kconfig
config SHIELD_GIBSON_LEFT
    def_bool $(shields_list_contains,gibson_left)

config SHIELD_GIBSON_RIGHT
    def_bool $(shields_list_contains,gibson_right)

config SHIELD_GIBSON_DONGLE
    def_bool $(shields_list_contains,gibson_dongle)
```
