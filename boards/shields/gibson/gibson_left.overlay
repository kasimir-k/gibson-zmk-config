// This file was generated from a template. Edit it to match your keyboard.
// See https://zmk.dev/docs/development/hardware-integration/new-shield for more
// instructions.

#include "gibson.dtsi"

&kscan {
    input-gpios
      = <&pro_micro 9  (GPIO_ACTIVE_LOW | GPIO_PULL_UP)>
      , <&pro_micro 6  (GPIO_ACTIVE_LOW | GPIO_PULL_UP)>
      , <&pro_micro 3  (GPIO_ACTIVE_LOW | GPIO_PULL_UP)>
      , <&pro_micro 1  (GPIO_ACTIVE_LOW | GPIO_PULL_UP)>
      , <&pro_micro 21 (GPIO_ACTIVE_LOW | GPIO_PULL_UP)>
    ;
};
