## boards/shields/gibson/Kconfig.defconfig
```kconfig
if SHIELD_GIBSON_LEFT || SHIELD_GIBSON_RIGHT || SHIELD_GIBSON_DONGLE

config ZMK_SPLIT
    default y

config ZMK_POINTING
    default y

config ZMK_POINTING_SMOOTH_SCROLLING
    default y

config SYSTEM_WORKQUEUE_STACK_SIZE
    default 4096

endif # SHIELD_GIBSON_LEFT || SHIELD_GIBSON_RIGHT || SHIELD_GIBSON_DONGLE

if SHIELD_GIBSON_DONGLE

config ZMK_KEYBOARD_NAME
    default "gibson"

config ZMK_SPLIT_ROLE_CENTRAL
    default y

config ZMK_SPLIT_BLE_CENTRAL_PERIPHERALS
    default 2

config BT_MAX_CONN
    default 6

config BT_MAX_PAIRED
    default 6

endif # SHIELD_GIBSON_DONGLE
```
