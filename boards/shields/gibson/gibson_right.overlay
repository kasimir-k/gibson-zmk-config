#include "gibson.dtsi"

&default_transform {
    col-offset = <5>;
};

&kscan {
    input-gpios
      = <&pro_micro 4  (GPIO_ACTIVE_LOW | GPIO_PULL_UP)>
      , <&pro_micro 21 (GPIO_ACTIVE_LOW | GPIO_PULL_UP)>
      , <&pro_micro 19 (GPIO_ACTIVE_LOW | GPIO_PULL_UP)>
      , <&pro_micro 14 (GPIO_ACTIVE_LOW | GPIO_PULL_UP)>
      , <&pro_micro 10 (GPIO_ACTIVE_LOW | GPIO_PULL_UP)>
    ;
};
